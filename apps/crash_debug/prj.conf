## CMakeLists.txt
```
cmake_minimum_required(VERSION 3.20.0)

# Shared libraries (crash_log, device_shell) are auto-discovered
# via zephyr/module.yml — no ZEPHYR_EXTRA_MODULES needed.

# Flash-based coredump with shell + crash_log + device_shell
list(APPEND OVERLAY_CONFIG "${CMAKE_CURRENT_LIST_DIR}/../../lib/crash_log/conf/debug_base.conf")
list(APPEND OVERLAY_CONFIG "${CMAKE_CURRENT_LIST_DIR}/../../lib/crash_log/conf/debug_coredump_flash.conf")
list(APPEND OVERLAY_CONFIG "${CMAKE_CURRENT_LIST_DIR}/../../lib/device_shell/device_shell.conf")

# Board-specific DTS overlays for coredump flash partition
# are auto-discovered from boards/ directory

find_package(Zephyr REQUIRED HINTS $ENV{ZEPHYR_BASE})
project(crash_debug)

target_sources(app PRIVATE src/main.c)
```

## prj.conf
```kconfig
CONFIG_MAIN_STACK_SIZE=2048
CONFIG_REBOOT=y
```

## prj_rtt_only.conf
```kconfig
# RTT-only coredump variant — no flash storage, no crash_log.
# Coredump streams through RTT at crash time. Simpler but data is
# lost if no one is reading RTT when the crash happens.
#
# Build with: west build -b <board> -- -DOVERLAY_CONFIG=prj_rtt_only.conf
# Or via MCP: zephyr-build.build(app="crash_debug", board="...", extra_args="-DOVERLAY_CONFIG=prj_rtt_only.conf")

CONFIG_MAIN_STACK_SIZE=2048

# Coredump subsystem — logging backend (streams via RTT)
CONFIG_DEBUG_COREDUMP=y
CONFIG_DEBUG_COREDUMP_BACKEND_LOGGING=y
CONFIG_DEBUG_COREDUMP_MEMORY_DUMP_MIN=y

# RTT logging
CONFIG_LOG=y
CONFIG_USE_SEGGER_RTT=y
CONFIG_LOG_BACKEND_RTT=y
CONFIG_LOG_BACKEND_UART=n
CONFIG_RTT_CONSOLE=y
CONFIG_UART_CONSOLE=n
CONFIG_SEGGER_RTT_BUFFER_SIZE_UP=4096

# Debug-friendly
CONFIG_DEBUG_OPTIMIZATIONS=y
CONFIG_DEBUG_THREAD_INFO=y
CONFIG_EXTRA_EXCEPTION_INFO=y
```

## boards/nrf52840dk_nrf52840.overlay
```dts
/*
 * Coredump flash partition for nRF52840DK
 * See lib/crash_log/boards/ for details.
 */

&flash0 {
	partitions {
		/delete-node/ partition@f8000;

		storage_partition: partition@f8000 {
			label = "storage";
			reg = <0x000f8000 0x00005000>;
		};

		coredump_partition: partition@fd000 {
			label = "coredump";
			reg = <0x000fd000 0x00003000>;
		};
	};
};
```

## boards/nrf5340dk_nrf5340_cpuapp.overlay
```dts
/*
 * Coredump flash partition for nRF5340DK
 *
 * nRF5340 cpuapp has 1MB flash (0x0 to 0x100000).
 * Default storage_partition is 32KB at 0xF8000-0x100000.
 * Shrink storage to 20KB to make room for 12KB coredump.
 *   Storage:  0xF8000-0xFD000 (20KB, was 32KB)
 *   Coredump: 0xFD000-0x100000 (12KB)
 */

&flash0 {
	partitions {
		/delete-node/ partition@f8000;

		storage_partition: partition@f8000 {
			label = "storage";
			reg = <0x000f8000 0x00005000>;
		};

		coredump_partition: partition@fd000 {
			label = "coredump";
			reg = <0x000fd000 0x00003000>;
		};
	};
};
```

## src/main.c
```c
#include <zephyr/kernel.h>
#include <zephyr/logging/log.h>

LOG_MODULE_REGISTER(crash_debug, LOG_LEVEL_INF);

/*
 * Crash debug demo app.
 *
 * Demonstrates automated crash analysis with the crash_log library:
 *   1. Boot — crash_log auto-checks for stored coredump (SYS_INIT)
 *   2. If previous crash found — emits #CD: data via RTT automatically
 *   3. After 5 seconds — triggers a NULL pointer write (MPU FAULT)
 *   4. Zephyr coredump subsystem stores crash to flash partition
 *   5. On next boot — step 1 detects and reports the crash
 *
 * Shell commands available via RTT:
 *   crash check  — check for stored crash
 *   crash info   — show crash PC, LR, fault reason
 *   crash dump   — output stored crash as #CD: lines
 *   crash clear  — erase stored crash
 *   board info   — board and firmware info
 *   board uptime — time since boot
 */

static void sensor_read_register(uint32_t reg_addr)
{
	volatile uint32_t *ptr = (volatile uint32_t *)0x0;

	LOG_INF("Reading sensor register 0x%x", reg_addr);
	*ptr = 0xDEAD; /* NULL pointer write -> HardFault */
}

static void sensor_process_data(const char *name)
{
	LOG_INF("Processing: %s", name);
	sensor_read_register(0xBEEF);
}

static void sensor_init_sequence(void)
{
	LOG_INF("Starting sensor init");
	sensor_process_data("accelerometer");
}

int main(void)
{
	LOG_INF("Crash debug app booted");
	LOG_INF("Shell available — try 'crash check' or 'board info'");
	LOG_INF("Crashing in 5 seconds...");

	k_sleep(K_SECONDS(5));

	LOG_INF("Triggering crash now!");
	sensor_init_sequence();

	return 0;
}
```
