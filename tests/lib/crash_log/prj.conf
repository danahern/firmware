## CMakeLists.txt
```
cmake_minimum_required(VERSION 3.20.0)

list(APPEND ZEPHYR_EXTRA_MODULES
    ${CMAKE_CURRENT_LIST_DIR}/../../../lib/crash_log
)

find_package(Zephyr REQUIRED HINTS $ENV{ZEPHYR_BASE})
project(crash_log_test)

target_sources(app PRIVATE src/main.c)
```

## prj.conf
```kconfig
CONFIG_ZTEST=y
CONFIG_MAIN_STACK_SIZE=2048

# Coredump subsystem — in-memory backend (works on QEMU, no flash needed)
CONFIG_DEBUG_COREDUMP=y
CONFIG_DEBUG_COREDUMP_BACKEND_IN_MEMORY=y
CONFIG_DEBUG_COREDUMP_MEMORY_DUMP_MIN=y

# Crash log module (no auto-report in tests — we test it explicitly)
CONFIG_CRASH_LOG=y
CONFIG_CRASH_LOG_AUTO_REPORT=n
CONFIG_CRASH_LOG_SHELL=n
```

## boards/nrf52840dk_nrf52840.overlay
```dts
/*
 * Coredump flash partition for nRF52840DK
 *
 * nRF52840 has 1MB flash. Storage ends at 0x100000.
 * Shrink storage by 12KB to make room for coredump.
 * Storage: 0xF8000-0xFD000 (20KB, was 32KB)
 * Coredump: 0xFD000-0x100000 (12KB)
 */

&flash0 {
	partitions {
		/delete-node/ partition@f8000;

		storage_partition: partition@f8000 {
			label = "storage";
			reg = <0x000f8000 0x00005000>;
		};

		coredump_partition: partition@fd000 {
			label = "coredump";
			reg = <0x000fd000 0x00003000>;
		};
	};
};
```

## boards/qemu_cortex_m3.overlay
```dts
/*
 * Coredump flash partition for qemu_cortex_m3 tests.
 * Flash is 256KB (0x0 - 0x40000).
 * Place 12KB coredump partition at the end.
 */

&flash0 {
	partitions {
		compatible = "fixed-partitions";
		#address-cells = <1>;
		#size-cells = <1>;

		coredump_partition: partition@3d000 {
			label = "coredump";
			reg = <0x3d000 0x3000>;
		};
	};
};
```

## src/main.c
```c
#include <zephyr/ztest.h>
#include <zephyr/debug/coredump.h>
#include <crash_log.h>

/*
 * crash_log API tests.
 *
 * These test the C API on a clean boot (no stored coredump).
 * Testing with an actual stored coredump requires triggering a fault
 * and rebooting, which is better done as a hardware integration test.
 */

ZTEST(crash_log, test_no_coredump_on_clean_boot)
{
	zassert_false(crash_log_has_coredump(),
		      "No coredump should exist on fresh boot");
}

ZTEST(crash_log, test_emit_returns_enoent_when_empty)
{
	int ret = crash_log_emit();

	zassert_equal(ret, -ENOENT,
		      "crash_log_emit should return -ENOENT when no dump, got %d",
		      ret);
}

ZTEST(crash_log, test_clear_succeeds_when_empty)
{
	int ret = crash_log_clear();

	zassert_equal(ret, 0,
		      "crash_log_clear should succeed even when empty, got %d",
		      ret);
}

ZTEST(crash_log, test_still_empty_after_clear)
{
	crash_log_clear();

	zassert_false(crash_log_has_coredump(),
		      "No coredump should exist after clear");
}

ZTEST_SUITE(crash_log, NULL, NULL, NULL, NULL, NULL);
```
