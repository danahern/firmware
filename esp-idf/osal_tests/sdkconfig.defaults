## esp-idf/osal_tests/sdkconfig.defaults
```kconfig
# Unity test framework
CONFIG_UNITY_ENABLE_FLOAT=y

# FreeRTOS config for OSAL
CONFIG_FREERTOS_TIMER_TASK_STACK_DEPTH=4096
CONFIG_FREERTOS_HZ=1000
```

## lib/Kconfig
```kconfig
rsource "crash_log/Kconfig"
rsource "device_shell/Kconfig"
rsource "eai_ble/Kconfig"
rsource "eai_log/Kconfig"
rsource "eai_osal/Kconfig"
rsource "eai_settings/Kconfig"
rsource "eai_ipc/Kconfig"
rsource "eai_audio/Kconfig"
rsource "eai_wifi/Kconfig"
rsource "wifi_prov/Kconfig"
```

## lib/crash_log/Kconfig
```kconfig
config CRASH_LOG
	bool "Crash log - boot-time coredump detection"
	depends on DEBUG_COREDUMP
	depends on DEBUG_COREDUMP_BACKEND_FLASH_PARTITION || DEBUG_COREDUMP_BACKEND_IN_MEMORY
	help
	  Checks for stored coredump on boot and logs status.
	  Provides a C API: crash_log_has_coredump(), crash_log_clear().
	  Works with both flash partition and in-memory coredump backends.

config CRASH_LOG_AUTO_REPORT
	bool "Auto-report stored coredump on boot"
	depends on CRASH_LOG
	default y
	help
	  On boot, if a stored coredump is found, automatically emit it
	  as #CD: prefixed hex lines via logging. This makes it capturable
	  by the analyze_coredump MCP tool through RTT.

config CRASH_LOG_SHELL
	bool "Crash shell commands"
	depends on CRASH_LOG
	depends on SHELL
	default y if SHELL
	help
	  Adds crash management commands to the shell:
	    crash check  - Check if a stored coredump exists
	    crash info   - Show crash summary (registers from header)
	    crash dump   - Output stored coredump as #CD: lines
	    crash clear  - Erase stored coredump
```

## lib/device_shell/Kconfig
```kconfig
config DEVICE_SHELL
	bool "Device shell commands"
	depends on SHELL
	help
	  Adds board info and management commands to the shell:
	    board info    - Board, firmware version, build date
	    board uptime  - Time since boot
	    board reset   - Software reset
```

## lib/eai_audio/Kconfig
```kconfig
menuconfig EAI_AUDIO
	bool "EAI Audio - Portable Audio HAL"
	help
	  Portable audio abstraction layer mirroring Android Audio HAL concepts.
	  Provides port enumeration, stream I/O, gain control, routing, and
	  optional software mixer. Backend is selected at compile time.

if EAI_AUDIO

choice EAI_AUDIO_BACKEND
	prompt "Audio Backend"
	default EAI_AUDIO_BACKEND_ZEPHYR

config EAI_AUDIO_BACKEND_ZEPHYR
	bool "Zephyr I2S backend"
	depends on I2S
	help
	  Uses Zephyr I2S API for audio I/O. Discovers ports via devicetree.

endchoice

config EAI_AUDIO_MIXER
	bool "Software mixer (mini-flinger)"
	default y
	depends on EAI_OSAL
	help
	  Lightweight software mixer that combines multiple output streams
	  before sending to hardware. Uses an eai_osal thread for mixing.

config EAI_AUDIO_MIXER_SLOTS
	int "Maximum mixer stream slots"
	default 4
	range 2 8
	depends on EAI_AUDIO_MIXER
	help
	  Number of pre-allocated output stream slots for mixing.

config EAI_AUDIO_MAX_PORTS
	int "Maximum audio ports"
	default 4
	range 2 16
	help
	  Maximum number of audio ports (speakers, mics, I2S, etc.).

config EAI_AUDIO_MAX_ROUTES
	int "Maximum audio routes"
	default 4
	range 1 16
	help
	  Maximum number of simultaneous source-to-sink routes.

endif # EAI_AUDIO
```

## lib/eai_display/Kconfig
```kconfig
menuconfig EAI_DISPLAY
	bool "EAI Display - Portable Display HAL"
	help
	  Portable display abstraction layer inspired by Android HWComposer.
	  Provides device enumeration, layer-based compositing, brightness
	  control, and vsync. Backend is selected at compile time.

if EAI_DISPLAY

choice EAI_DISPLAY_BACKEND
	prompt "Display Backend"
	default EAI_DISPLAY_BACKEND_ZEPHYR

config EAI_DISPLAY_BACKEND_ZEPHYR
	bool "Zephyr Display API backend"
	depends on DISPLAY
	help
	  Uses Zephyr Display API. Discovers displays via devicetree.

endchoice

config EAI_DISPLAY_MAX_DEVICES
	int "Maximum display devices"
	default 2
	range 1 4
	help
	  Maximum number of display devices.

config EAI_DISPLAY_MAX_LAYERS
	int "Maximum layers per display"
	default 4
	range 1 8
	help
	  Maximum number of simultaneously open layers.

endif # EAI_DISPLAY
```

## lib/eai_input/Kconfig
```kconfig
menuconfig EAI_INPUT
	bool "EAI Input - Portable Input HAL"
	help
	  Portable input abstraction layer inspired by Android EventHub.
	  Provides device enumeration, event callback and polling modes.
	  Supports touch, button, encoder, keyboard, and gesture devices.
	  Backend is selected at compile time.

if EAI_INPUT

choice EAI_INPUT_BACKEND
	prompt "Input Backend"
	default EAI_INPUT_BACKEND_ZEPHYR

config EAI_INPUT_BACKEND_ZEPHYR
	bool "Zephyr Input subsystem backend"
	depends on INPUT
	help
	  Uses Zephyr Input subsystem. Discovers devices via devicetree.

endchoice

config EAI_INPUT_MAX_DEVICES
	int "Maximum input devices"
	default 8
	range 1 16
	help
	  Maximum number of input devices.

endif # EAI_INPUT
```

## lib/eai_ipc/Kconfig
```kconfig
menuconfig EAI_IPC
	bool "EAI IPC - Portable Inter-Processor Communication"
	help
	  Endpoint-based messaging abstraction with backends for
	  Zephyr IPC Service and an in-process loopback for testing.

if EAI_IPC

choice EAI_IPC_BACKEND
	prompt "IPC Backend"
	default EAI_IPC_BACKEND_LOOPBACK

config EAI_IPC_BACKEND_ZEPHYR
	bool "Zephyr IPC Service backend"
	depends on IPC_SERVICE
	help
	  Wraps Zephyr IPC Service (RPMsg/ICMsg). Requires an ipc0
	  node in devicetree.

config EAI_IPC_BACKEND_LOOPBACK
	bool "Loopback backend (testing)"
	help
	  In-process endpoint pairing by name. Send triggers peer's
	  on_received synchronously. Works on QEMU and native.

endchoice

config EAI_IPC_MAX_ENDPOINTS
	int "Maximum number of loopback endpoints"
	default 8
	depends on EAI_IPC_BACKEND_LOOPBACK
	help
	  Maximum number of endpoints the loopback backend can track.

config EAI_IPC_LOOPBACK_MAX_PACKET_SIZE
	int "Loopback maximum packet size"
	default 496
	depends on EAI_IPC_BACKEND_LOOPBACK
	help
	  Maximum payload size for loopback send. Matches typical RPMsg limit.

endif # EAI_IPC
```

## lib/eai_ipc/tests/testcase.yaml
```yaml
common:
  tags:
    - eai_ipc
tests:
  libraries.eai_ipc:
    integration_platforms:
      - qemu_cortex_m3
```

## lib/eai_sensor/Kconfig
```kconfig
menuconfig EAI_SENSOR
	bool "EAI Sensor - Portable Sensor HAL"
	help
	  Portable sensor abstraction layer mirroring Android ISensors concepts.
	  Provides device enumeration, session-based streaming with callbacks
	  and polling, configurable rate. Backend is selected at compile time.

if EAI_SENSOR

choice EAI_SENSOR_BACKEND
	prompt "Sensor Backend"
	default EAI_SENSOR_BACKEND_ZEPHYR

config EAI_SENSOR_BACKEND_ZEPHYR
	bool "Zephyr Sensor API backend"
	depends on SENSOR
	help
	  Uses Zephyr Sensor API. Discovers sensors via devicetree.

endchoice

config EAI_SENSOR_MAX_DEVICES
	int "Maximum sensor devices"
	default 8
	range 1 32
	help
	  Maximum number of sensor devices.

config EAI_SENSOR_MAX_SESSIONS
	int "Maximum concurrent sensor sessions"
	default 4
	range 1 16
	help
	  Maximum number of simultaneously open sensor sessions.

endif # EAI_SENSOR
```

## lib/wifi_prov/Kconfig
```kconfig
config WIFI_PROV
	bool "WiFi provisioning library"
	depends on EAI_LOG
	help
	  WiFi provisioning over BLE. Provides a custom GATT service
	  for scanning WiFi APs, sending credentials, and managing
	  connection state. Credentials persist across reboots.

config WIFI_PROV_BLE
	bool "BLE GATT service for WiFi provisioning"
	depends on WIFI_PROV
	depends on EAI_BLE
	help
	  Custom BLE GATT service with characteristics for scan trigger,
	  scan results, credentials, status, and factory reset.

config WIFI_PROV_WIFI
	bool "WiFi manager (scan/connect)"
	depends on WIFI_PROV
	depends on EAI_WIFI
	help
	  WiFi scanning and connection using eai_wifi abstraction.

config WIFI_PROV_CRED
	bool "Credential persistence"
	depends on WIFI_PROV
	depends on EAI_SETTINGS
	default y if WIFI_PROV
	help
	  Store/load/erase WiFi credentials using eai_settings.

config WIFI_PROV_AUTO_CONNECT
	bool "Auto-connect on boot from stored credentials"
	depends on WIFI_PROV_WIFI
	depends on WIFI_PROV_CRED
	depends on EAI_OSAL
	default y
	help
	  If stored credentials exist at boot, automatically connect to WiFi.
```

## linux/yocto/meta-eai/conf/layer.conf
```bitbake
BBPATH .= ":${LAYERDIR}"
BBFILES += "${LAYERDIR}/recipes-*/*/*.bb ${LAYERDIR}/recipes-*/*/*.bbappend"
BBFILE_COLLECTIONS += "meta-eai"
BBFILE_PATTERN_meta-eai = "^${LAYERDIR}/"
BBFILE_PRIORITY_meta-eai = "7"
LAYERSERIES_COMPAT_meta-eai = "scarthgap"
```

## linux/yocto/meta-eai/conf/machine/appkit-e7.conf
```bitbake
# AppKit-E7 (AK-E7-AIML) Machine Configuration
#
# Based on appkit-e8.conf with E7-specific overrides:
#   - 32MB ISSI HyperRAM (not 64MB Macronix)
#   - ISSI OSPI flash (IS25WX256)
#   - DTB at 0x80200000 (SE REV_B4 minimum)
#   - ENABLE_PIE=1 required

# Include architecture-specific tuning for Cortex-A32
require ${ALIF_MSD_BASE}/conf/machine/include/arm/armv8a/tune-cortexa32.inc

DEFAULTTUNE = "cortexa32"

# Platform-specific settings
TF-A_PLATFORM = "devkit_e7"
BL32_IN_XIP_MEM ?= "1"
BL32_XIP_BASE ?= "0x80002000"
A32_HWSEM_MST_ID ?= "0xA1B2C3D4"
UART ??= "2"
SMP ?= "1"
BASE_IMAGE ??= "1"
BASE_IMAGE2 ??= "0"
BASE_IMAGE3 ??= "0"
BASE_IMAGE4 ??= "0"
BASE_IMAGE5 ??= "0"
BASE_IMAGE7 ??= "0"

# Common memory addresses
KERNEL_XIP_DEFAULT ?= "0x02000000"
KERNEL_XIP_HYPRAM ?= "0xA0000000"

# HYPRAM settings — E7 uses ISSI HyperRAM (32MB)
# HYPRAM_ONLY=1 tells the DCT tool to set MEM_HYPER_STATUS to "okay" in the DTB.
# Without this, upstream default is "disabled" and HyperRAM won't be available.
HYPRAM_ONLY = "1"

# PHYS_OFFSET stays at SRAM (0x02000000) — matching the working boot setup.
# HyperRAM is enabled in the DTB as additional memory but SRAM is the boot memory.
# XIP kernels can't use HyperRAM as PHYS_OFFSET because CONFIG_ARM_VIRT_EXT
# (needed for Hyp mode entry) depends on !XIP_KERNEL.
KERNEL_XIP_RAM = "${KERNEL_XIP_DEFAULT}"

# TF-A HyperRAM/flash init flags
# Note: TF-A only understands HYPRAM_EN and FLASH_EN (not ISSI_HYPERRAM_EN/AP_HYPERRAM_EN)
AP_HYPERRAM_EN = "0"
ISSI_HYPERRAM_EN = "1"

# Boot from OSPI
OSPI_BOOT ??= "${@'1' if d.getVar('BASE_IMAGE3') == '1' or d.getVar('BASE_IMAGE7') == '1' else '0'}"
OSPI_BOOT_ENC ??= "0"

# Include OSPI configuration files if enabled
include ${@bb.utils.contains('OSPI_BOOT', '1', 'conf/machine/include/ospi-config.inc','', d)}
include ${@bb.utils.contains('OSPI_BOOT_ENC', '1', 'conf/machine/include/ospi-enc-config.inc','', d)}

# E7 uses ISSI flash, not Macronix — override ospi-config.inc defaults
# (ospi-config.inc assumes appkit = Macronix, devkit = ISSI based on machine name prefix)
ISSI_FLASH_EN = "${@'1' if d.getVar('OSPI_BOOT') == '1' else '0'}"
MX_FLASH_EN = "0"

# Flash and encryption settings
AES_EN ??= "0"
AES_ENC_KEY ??= ""

ADC_MODE ??= "0"

# Trusted SRAM base — SRAM0 region (SEROM v1.100.0 doesn't support SRAM1 remap)
ALIF_TRUSTED_SRAM_BASE ??= "0x02300000"

# TF-A options — ENABLE_PIE required for E7
# Note: ENABLE_STACK_PROTECTOR=strong omitted — upstream TF-A is missing
# devkit_e7_stack_protector.c (referenced in Makefile but not in repo)
TF-A_EXTRA_OPTIONS += " \
            RESET_TO_SP_MIN=1 \
            ARM_LINUX_KERNEL_AS_BL33=1 \
            PRELOADED_BL33_BASE=${XIP_KERNEL_LOAD_ADDR} \
            ARM_PRELOADED_DTB_BASE=${KERNEL_DTB_ADDR} \
            ALIF_TRUSTED_SRAM_BASE=${ALIF_TRUSTED_SRAM_BASE} \
            ENABLE_PIE=1 \
            BL32_IN_XIP_MEM=${BL32_IN_XIP_MEM} \
            BL32_XIP_BASE=${BL32_XIP_BASE} \
            AP_HYPERRAM_EN=${AP_HYPERRAM_EN} \
            ISSI_HYPERRAM_EN=${ISSI_HYPERRAM_EN} \
            MX_FLASH_EN=${MX_FLASH_EN} \
            ISSI_FLASH_EN=${ISSI_FLASH_EN} \
            AES_EN=${AES_EN} \
            AES_ENC_KEY=${AES_ENC_KEY} \
            UART=${UART} \
            "

# Kernel image and device tree settings
KERNEL_IMAGETYPE = "xipImage"
KERNEL_DEVICETREE = "${@bb.utils.contains('SMP', '0', 'alif/ensemble/appkit/appkit-e7.dtb', 'alif/ensemble/appkit/appkit-e7.dtb', d)}"
KBUILD_DEFCONFIG = "appkit_e8_defconfig"
KERNEL_DTB_ADDR ?= "0x80200000"
XIP_KERNEL_LOAD_ADDR ?= "0x80020000"
KERNEL_MTD_START_ADDR ?= "${@'0xC0000000' if d.getVar('BASE_IMAGE2') == '1' else '0x80380000'}"
KERNEL_MTD_LEN ?= "${@'0x400000' if d.getVar('BASE_IMAGE2') == '1' else '200000'}"

# Preferred kernel provider
PREFERRED_PROVIDER_virtual/kernel:forcevariable = "linux-alif"

# DCT tool settings
DTS_MACRO_FILE ?= "/arch/arm/boot/dts/alif/ensemble/common/devkit_ex_dct_defines.h"
DTS_MACRO_FILE_ORG ?= "/arch/arm/boot/dts/alif/ensemble/common/devkit_ex_dct_defines.h.org"

# Serial console settings
SERIAL_CONSOLES ?= "115200;ttyS0 ${@bb.utils.contains('DISTRO_FEATURES', 'apss-debug', '', '115200;ttyS1 115200;ttyS2 115200;ttyS3', d)}"
```

## linux/yocto/meta-eai/conf/machine/appkit-e8.conf
```bitbake
# AppKit-E8 Machine Configuration (meta-eai overrides)
#
# Overrides stock meta-alif-ensemble appkit-e8.conf for MRAM-only boot:
#   - 64MB Macronix HyperRAM (disabled until TF-A rebuilt)
#   - SRAM1 at 0x02400000 (NOT 0x08000000 like E7)
#   - MTD physmap at 0x80400000 (after ~4MB kernel with USB)
#   - UART4 for console
#   - DTB at 0x80010000

# Include architecture-specific tuning for Cortex-A32
require ${ALIF_MSD_BASE}/conf/machine/include/arm/armv8a/tune-cortexa32.inc

DEFAULTTUNE = "cortexa32"

# Platform-specific settings
TF-A_PLATFORM = "devkit_e7"
BL32_IN_XIP_MEM ?= "1"
BL32_XIP_BASE ?= "0x80002000"
A32_HWSEM_MST_ID ?= "0xA1B2C3D4"
UART ??= "4"
SMP ?= "1"
BASE_IMAGE ??= "1"
BASE_IMAGE2 ??= "0"
BASE_IMAGE3 ??= "0"
BASE_IMAGE4 ??= "0"
BASE_IMAGE5 ??= "0"
BASE_IMAGE7 ??= "0"

# Common memory addresses
KERNEL_XIP_DEFAULT ?= "0x02000000"
KERNEL_XIP_HYPRAM ?= "0xA0000000"

# HyperRAM disabled for now — TF-A not built with HYPRAM_EN
HYPRAM_ONLY = ""
KERNEL_XIP_RAM = "${KERNEL_XIP_DEFAULT}"
AP_HYPERRAM_EN = "0"
ISSI_HYPERRAM_EN = "0"

# No OSPI boot (MRAM only)
OSPI_BOOT = "0"
OSPI_BOOT_ENC ??= "0"
MX_FLASH_EN = "0"
ISSI_FLASH_EN = "0"

# Flash and encryption settings
AES_EN ??= "0"
AES_ENC_KEY ??= ""

ADC_MODE ??= "0"

# Trusted SRAM base — E8 SRAM1 at 0x02400000 (end of SRAM0+SRAM1 minus 128KB)
ALIF_TRUSTED_SRAM_BASE ??= "0x027DE000"

# TF-A options — hand-built TF-A used (Yocto TF-A has broken flag names)
TF-A_EXTRA_OPTIONS += " \
            RESET_TO_SP_MIN=1 \
            ARM_LINUX_KERNEL_AS_BL33=1 \
            PRELOADED_BL33_BASE=${XIP_KERNEL_LOAD_ADDR} \
            ARM_PRELOADED_DTB_BASE=${KERNEL_DTB_ADDR} \
            ALIF_TRUSTED_SRAM_BASE=${ALIF_TRUSTED_SRAM_BASE} \
            ENABLE_PIE=1 \
            BL32_IN_XIP_MEM=${BL32_IN_XIP_MEM} \
            BL32_XIP_BASE=${BL32_XIP_BASE} \
            AP_HYPERRAM_EN=${AP_HYPERRAM_EN} \
            ISSI_HYPERRAM_EN=${ISSI_HYPERRAM_EN} \
            MX_FLASH_EN=${MX_FLASH_EN} \
            ISSI_FLASH_EN=${ISSI_FLASH_EN} \
            AES_EN=${AES_EN} \
            AES_ENC_KEY=${AES_ENC_KEY} \
            UART=${UART} \
            "

# Kernel image and device tree settings
KERNEL_IMAGETYPE = "xipImage"
KERNEL_DEVICETREE = "alif/ensemble/appkit/appkit-e8.dtb"
KBUILD_DEFCONFIG = "appkit_e8_defconfig"
KERNEL_DTB_ADDR ?= "0x80010000"
XIP_KERNEL_LOAD_ADDR ?= "0x80020000"
# MTD physmap: rootfs starts at 0x80400000 (after ~4MB kernel with USB configs)
KERNEL_MTD_START_ADDR ?= "0x80400000"
KERNEL_MTD_LEN ?= "0x180000"

# Preferred kernel provider
PREFERRED_PROVIDER_virtual/kernel:forcevariable = "linux-alif"

# DCT tool settings
DTS_MACRO_FILE ?= "/arch/arm/boot/dts/alif/ensemble/common/devkit_ex_dct_defines.h"
DTS_MACRO_FILE_ORG ?= "/arch/arm/boot/dts/alif/ensemble/common/devkit_ex_dct_defines.h.org"

# Serial console settings
SERIAL_CONSOLES ?= "115200;ttyS0"
```

## tests/lib/crash_log/testcase.yaml
```yaml
common:
  tags:
    - crash_log
    - coredump
tests:
  libraries.crash_log:
    # In-memory coredump backend — runs on QEMU, no flash needed.
    integration_platforms:
      - qemu_cortex_m3
```
